## Documentation/devicetree/bindings/ipmi/phytium,e2000-bt-bmc.txt
```
Phytium BT (Block Transfer) IPMI interface

The Phytium E-series SOCs (E2000) can be used in BMC which
have a BT interface used to perform in-band IPMI communication
with their host.

Required properties:

- compatible : should be one of
               "phytium,e2000-bt-bmc"
- reg: physical address and size of the registers
- interrupts: interrupt generated by the BT interface.

Example:

	bt: bt@250 {
		compatible = "phytium,e2000-bt-bmc";
		reg = <0x250 0x1c>;
		interrupts = <GIC_SPI 88 IRQ_TYPE_LEVEL_HIGH>;
	};
```
